## components/nilan_edge/Kconfig.projbuild
```kconfig
config NILAN_ENABLE_DEV_OTA
    bool "Enable local development OTA and reboot endpoints"
    default y
    help
        Enable unauthenticated local-network OTA and reboot endpoints for
        commissioning. Disable this option for production firmware until the
        endpoint has authentication and transport protection.

config NILAN_ENABLE_DEV_DIAGNOSTICS
    bool "Enable local raw CTS602 diagnostics"
    default y
    help
        Expose raw read-only CTS602 register words for commissioning. Disable
        this option for production firmware.

config NILAN_ENABLE_DEV_WRITES
    bool "Enable local development write tests"
    default y
    help
        Enable the bounded ventilation write endpoint for commissioning.
        Disable this option for production firmware.

config NILAN_ENABLE_MQTT_COMMANDS
    bool "Enable Nilan MQTT v2 command subscriptions"
    default n
    help
        Subscribe to validated Nilan command topics. Disable until MQTT ACL
        provisioning and production authorization are in place.
```

## sdkconfig.defaults
```kconfig
CONFIG_IDF_TARGET="esp32s3"
CONFIG_LOG_DEFAULT_LEVEL_INFO=y
CONFIG_FREERTOS_HZ=1000
CONFIG_PARTITION_TABLE_CUSTOM=y
CONFIG_PARTITION_TABLE_CUSTOM_FILENAME="partitions.csv"
CONFIG_BOOTLOADER_APP_ROLLBACK_ENABLE=y
CONFIG_APP_PROJECT_VER_FROM_CONFIG=y
CONFIG_APP_PROJECT_VER="0.3.1"
CONFIG_ESPTOOLPY_FLASHSIZE_16MB=y
CONFIG_ESPTOOLPY_FLASHSIZE="16MB"
CONFIG_SPIRAM=y
CONFIG_SPIRAM_MODE_OCT=y
CONFIG_SPIRAM_TYPE_AUTO=y
CONFIG_NILAN_ENABLE_DEV_OTA=y
CONFIG_NILAN_ENABLE_DEV_DIAGNOSTICS=y
CONFIG_NILAN_ENABLE_DEV_WRITES=y
CONFIG_NILAN_ENABLE_MQTT_COMMANDS=y
```
